// SPDX-License-Identifier: GPL-2.0+
/*
 * Radxa ROCK 4B+ (RK3399 / OP1) additions to the U-Boot device tree.
 *
 * WHY THIS FILE HAS TO EXIST
 *
 * U-Boot looks for a file of exactly this name and silently does without it:
 *
 *   scripts/Makefile.lib:200
 *     u_boot_dtsi_options = $(strip $(wildcard $(u_boot_dtsi_loc)$(basename $(notdir $<))-u-boot.dtsi) ...)
 *
 * The basename of rk3399-rock-4b-plus.dts is matched against
 * arch/arm/dts/rk3399-rock-4b-plus-u-boot.dtsi.  No file with that name exists,
 * so the first match falls through to the generic rk3399-u-boot.dtsi, and the
 * board .dtb ends up as the board .dts plus that generic layer -- which is
 * enough to satisfy binman and to mark nodes for the SPL, but not enough to
 * initialise DRAM.
 *
 * rk3399-u-boot.dtsi and its rockchip-u-boot.dtsi do not carry
 * rockchip,sdram-params.  The TPL therefore reaches
 * drivers/ram/rockchip/sdram_rk3399.c:rk3399_dmc_of_to_plat(), dev_read_u32_array()
 * returns FDT_ERR_NOTFOUND (-1), and the board stops before the SPL ever runs:
 *
 *   U-Boot TPL 2025.10-OpenWrt-r33051-f5dae5ece4 (Jun 29 2026 - 12:59:20)
 *   rk3399_dmc_of_to_plat: Cannot read rockchip,sdram-params -1
 *   DRAM init failed: -1
 *   Trying to boot from BOOTROM
 *
 * Nothing in the build says so.  There is no warning, no failing target, and the
 * resulting idbloader.img is not distinguishable from a working one by size --
 * the failure only shows up if that bootloader is put on the SPI, at which point
 * the board is bricked with no way to write a different one.
 *
 * Every other RK3399 board in U-Boot has one of these files: rock-pi-4a,
 * rock-pi-4c, rock-4c-plus, rock-4se, nanopc-t4.  That is why those boot and
 * this one did not.  The difference is visible in the compiled .dtb: adding the
 * parameters takes this board's from 90840 to 93704 bytes, and
 * rockchip,sdram-params is the only thing in it that changes.  A nanopc-t4
 * build of the same tree shows the same property and grows by 5720 instead,
 * because its blob is LPDDR3.
 *
 * WHAT IS INCLUDED, AND WHY ONLY THESE TWO
 *
 * Two includes, matching the shape of every other rk3399 board in U-Boot:
 *
 *   rk3399-u-boot.dtsi
 *       Carries the binman node -- CONFIG_BINMAN is enabled, and without a
 *       'binman' node in the control FDT the build stops at
 *       "binman: Device tree './u-boot.dtb' does not have a 'binman' node" --
 *       and the bootph-all / bootph-pre-ram marks that keep nodes in the SPL and
 *       TPL device trees.
 *
 *       It has to be included here explicitly, and that is the subtle part.
 *       scripts/Makefile.lib builds a priority chain, not a union:
 *
 *         u_boot_dtsi_options = $(strip $(wildcard <board>-u-boot.dtsi) \
 *                                $(wildcard $(CONFIG_SYS_SOC)-u-boot.dtsi) ...)
 *         # We use the first match to be included
 *         dtsi_include_list = $(notdir $(firstword $(u_boot_dtsi_options)))
 *
 *       So with no file named after this board, the first match is
 *       $(CONFIG_SYS_SOC)-u-boot.dtsi, i.e. rk3399-u-boot.dtsi, which is why
 *       binman was satisfied before this file existed -- and why the missing
 *       piece was only the DRAM parameters.
 *
 *       Adding this file makes it the first match, and rk3399-u-boot.dtsi then
 *       stops being included at all.  Creating the file without reproducing the
 *       chain inside it moves the failure from runtime (a bricked board) to
 *       build time (binman).  Include it, as nanopc-t4 does through
 *       rk3399-nanopc-t4-u-boot.dtsi -> rk3399-nanopi4-u-boot.dtsi -> here.
 *       DEVICE_TREE_DEBUG=y makes the build print which candidate matched.
 *
 *   rk3399-sdram-lpddr4-100.dtsi
 *       Nothing but &dmc { rockchip,sdram-params = <...> }, which is the property
 *       the TPL fails on.  The board has 64-bit dual-channel LPDDR4 at 3200 Mb/s
 *       (2 or 4 GB), and mainline U-Boot uses this same file for every RK3399
 *       board with that memory: rk3399-rock-pi-4-u-boot.dtsi includes exactly
 *       this one, and rock-pi-4a, rock-pi-4c, rock-4c-plus and rock-4se include
 *       that in turn.
 *
 * NOT INCLUDED: rk3399-rock-pi-4-u-boot.dtsi, which would be the obvious
 * one-liner, also pulls in &sdhci timing overrides (mmc-ddr-1_8v,
 * mmc-hs200-1_8v) and an leds node.  Those are defensible but they are not what
 * is missing here, and the eMMC already reaches HS400 without them.  On a board
 * that currently cannot boot, only the two things the build and the TPL actually
 * ask for should change.
 *
 * ADDED 2026-10-08: &vdd_log { regulator-init-microvolt = <950000> }
 *
 *   Once the board booted, this stopped being "not what is missing here".  That
 *   file is a long-standing omission on my part rather than a considered
 *   decision, and both files it would have pulled this from set the rail:
 *   rk3399-rock-pi-4-u-boot.dtsi and Radxa's own rk3399-rock-4c-plus-u-boot.dtsi
 *   both carry it.
 *
 *   Why it can matter: the kernel's own node for this rail, in
 *   rk3399-rock-pi-4.dtsi, is a pwm-regulator with regulator-always-on and only
 *   regulator-min/max-microvolt (800000..1400000) -- no regulator-init-microvolt.
 *   So nothing in the kernel picks a voltage; whatever U-Boot left is what the
 *   kernel keeps.  An unset PWM regulator is not obviously a valid operating
 *   point for the CPU and DDR logic rails.
 *
 *   What it is being tried against: this bootloader boots the board six times and
 *   panics the kernel on three, always with a function pointer aimed at
 *   non-code, while Armbian's TPL boots it every time with the same kernel,
 *   device tree and rootfs.  DRAM initialisation has been ruled out by
 *   experiment -- 0103-ram-rockchip-rk3399-lpddr4-configure-before-training.patch
 *   makes this bootloader's DRAM sequence identical to Armbian's and the fault
 *   survives, reproducing the same corrupted pointer, 0xdfff800080099ee4.
 *   UNVERIFIED.  A wrong rail voltage is a plausible way to corrupt memory
 *   intermittently in the first second of kernel boot, and it is untested
 *   here; one boot would prove nothing, the threshold is six clean ones.
 *
 * NOT INCLUDED, deliberately, so a failure above is informative:
 *   &sdhci { cap-mmc-highspeed; mmc-ddr-1_8v; mmc-hs200-1_8v; }
 *       Affects eMMC, which already reaches HS400 and mounts rootfs.  No
 *       mechanism for corrupting memory.
 *   / { leds { led-0 { default-state = "on"; }; }; }
 *       Cosmetic.
 *   Adding either alongside the vdd_log change would mean a failure could not
 *   be attributed, and these are cheap to add afterwards.
 *
 * No spi1/flash@0 node is added either.  SPI boot on this board goes through
 * CONFIG_ROCKCHIP_SPI_IMAGE rather than the MMC-style flash node lookup, and the
 * working nanopc-t4 .dtb contains no flash@0 node either.
 */

#include "rk3399-u-boot.dtsi"
#include "rk3399-sdram-lpddr4-100.dtsi"

&vdd_log {
	/*
	 * &vdd_log { regulator-init-microvolt = <950000> }
	 *
	 * This is the whole fix, and it is one property.
	 *
	 * ⚠️ WITHOUT IT, U-Boot never programs the PWM duty at all. Not because it
	 * fails to, but because it is never asked:
	 *
	 *   drivers/power/regulator/pwm_regulator.c
	 *     107: init_voltage = dev_read_u32_default(dev, "regulator-init-microvolt", -1);
	 *     109:     printf("Cannot find regulator pwm init_voltage\n");
	 *     134: if (priv->init_voltage)
	 *     135:     pwm_regulator_set_voltage(dev, priv->init_voltage);
	 *
	 * So with the property missing, set_voltage() is never called, and the only
	 * thing that touches the hardware is rk_pwm_set_enable(), which writes
	 * ctrl |= 0x3 and leaves period and duty at their reset values. The kernel
	 * cannot rescue it either: pwm_regulator_init_boot_on() starts with
	 *
	 *     if (pstate.enabled) return 0;
	 *
	 * and enabled is (ctrl & 0x3) == 0x3, which U-Boot just made true. So the
	 * kernel also writes nothing.
	 *
	 * Measured consequence: SDIO phase 269 and intermittent single-bit kernel
	 * corruption. That line of printf is the cleanest discriminator found in this
	 * port -- it appears in every 269-phase serial capture and in no other,
	 * without exception. scripts/classify-serial-logs.sh sorts captures by it.
	 *
	 * ⚠️ WHY 950000 AND NOT SOMETHING ELSE
	 *
	 * The value is not the fix -- the property's existence is. Measured, at duty
	 * 0%, 25% and 50%:
	 *
	 *     800000  (0%)       6/6 clean   phase 210-213
	 *     950000  (25%)     12/6 clean   phase 215-226
	 *     1100000 (50%)      6/6 clean   phase 232-234
	 *     (absent)                    phase 269 and panics
	 *
	 * So any explicit value passes, and the SDIO phase tracks it linearly
	 * (residual <= 0.1 phase over 30 boots). 950000 is chosen because:
	 *
	 *   1. Of upstream v2025.10's 32 RK3399 board -u-boot.dtsi files, the 11
	 *      that set this property all set it to exactly this value: rock-pi-4,
	 *      rock-4c-plus (Radxa's own sister board), rockpro64, firefly,
	 *      orangepi, khadas-edge, leez-p710, pinebook-pro, puma-haikou,
	 *      eaidk-610, roc-pc. None deviates; the other 21 do not set it at all.
	 *   2. It has the most measurements: 12 clean boots across two builds.
	 *   3. Its phase (215-226) brackets Armbian's (220-223), which is where the
	 *      silicon ends up when someone else's bootloader drives it. 800 mV
	 *      lands below that band and 1100 mV above it.
	 *
	 * ⚠️ 800 mV passing is NOT an argument for 800 mV. This rail is named
	 * vdd_log; the fact that the bottom of its range is stable says the rail is
	 * not a critical supply, not that undervolting it is fine.
	 *
	 * ⚠️ The rail is still not measured. Nothing has read its actual voltage:
	 * no multimeter, and regulator_summary reports the requested value, not the
	 * measured one. "950 mV" here means what the driver is told to program.
	 */
	regulator-init-microvolt = <950000>;
};
